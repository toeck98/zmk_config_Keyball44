/*
 * Copyright (c) 2020 ZMK Contributors
 *
 * SPDX-License-Identifier: MIT
 */
 
#include "keyball44.dtsi"

&default_transform {
    col-offset = <6>;
};

&kscan0 {
	col-gpios
		= <&pro_micro 4 GPIO_ACTIVE_HIGH>
		, <&pro_micro 5 GPIO_ACTIVE_HIGH>
		, <&pro_micro 6 GPIO_ACTIVE_HIGH>
		, <&pro_micro 7 GPIO_ACTIVE_HIGH>
		, <&pro_micro 8 GPIO_ACTIVE_HIGH>
        , <&pro_micro 9 GPIO_ACTIVE_HIGH>
		;
};

&pinctrl {
    spi1_default: spi1_default {
        group1 {
            psels = <NRF_PSEL(SPIM_SCK, 1, 13)>,
                <NRF_PSEL(SPIM_MOSI, 0, 10)>
        };
        group2 {
            psels = <NRF_PSEL(SPIM_MISO, 1, 11)>;
            input-enable;
        };
    };
};

&spi1 {
    status = "okay";
    cs-gpios = <&gpio0 9 GPIO_ACTIVE_LOW>;
    mouse: mouse@0 {
		compatible = "pixart,pmw3360";
		status = "okay";
		reg = <0>;
		spi-max-frequency = <2000000>;

		// pmw3360 driver parameters
		//irq-gpios = <&gpio0 27 (GPIO_ACTIVE_LOW | GPIO_PULL_UP)>;
		cpi = <600>;
		rotate-90;
	};
};

 {
	mouse_listener {
		compatible = "zmk,input-listener";
		device = <&mouse>;
	};
};
